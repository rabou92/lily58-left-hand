## config/west.yml
```yaml
manifest:
  remotes:
    - name: zmkfirmware
      url-base: https://github.com/zmkfirmware
    - name: mschmitt
      url-base: https://github.com/m-schmitt
  projects:
    - name: zmk
      remote: zmkfirmware
      revision: v0.3
      import: app/west.yml
    - name: nice-view-gem
      remote: M165437
      revision: v0.3
  self:
    path: config
```
